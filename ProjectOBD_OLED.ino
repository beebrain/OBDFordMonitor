/*************************************************************************
* Testing sketch for Freematics OBD-II UART Adapter
* Reads and prints several OBD-II PIDs value
* Distributed under GPL v2.0
* Visit http://freematics.com for more information
* Written by Stanley Huang <stanleyhuangyc@gmail.com>
*************************************************************************/


#include "OBD2.h"
#include <SPI.h>
#include <Wire.h>
#include <Adafruit_GFX.h>
#include <Adafruit_SSD1306.h>
#define OLED_RESET 4
Adafruit_SSD1306 display(OLED_RESET);

#define NUMFLAKES 10
#define XPOS 0
#define YPOS 1
#define DELTAY 2


#define LOGO16_GLCD_HEIGHT 16 
#define LOGO16_GLCD_WIDTH  16 

#if (SSD1306_LCDHEIGHT != 64)
#error("Height incorrect, please fix Adafruit_SSD1306.h!");
#endif


static const byte pids[] = {PID_SPEED, PID_ENGINE_LOAD, PID_THROTTLE, PID_COOLANT_TEMP, PID_RPM,PID_CONTROL_MODULE_VOLTAGE,PID_FUEL_LEVEL};
int values[sizeof(pids)];
    
float volt=0;
char command;
char format_string[20];
// On Arduino Leonardo, Micro, MEGA or DUE, hardware serial can be used for output
// as OBD-II UART adapter connects to Serial1, otherwise we use software serial

COBD obd;

static const unsigned char PROGMEM test [] = {
0x00, 0x00, 0x00, 0x00, 0x00, 0x00, 0x00, 0x00, 0x00, 0x00, 0x00, 0x00, 0x00, 0x00, 0x00, 0x00,
0x0F, 0xFF, 0xFF, 0xFF, 0xFF, 0xFF, 0xFF, 0xFF, 0xFF, 0xFF, 0xFF, 0xFF, 0xFF, 0xFF, 0xFF, 0xF0,
0x08, 0x00, 0x00, 0x00, 0x00, 0x00, 0x00, 0x01, 0x80, 0x00, 0x00, 0x00, 0x00, 0x00, 0x00, 0x10,
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0x00, 0x00, 0x00, 0x00, 0x00, 0x00, 0x00, 0x00, 0x00, 0x00, 0x00, 0x00, 0x00, 0x00, 0x00, 0x00
};


static const unsigned char PROGMEM TempLogo[] =
{
0xFF, 0xFF, 0xFF, 0xFF, 0xFF, 0xFF, 0xFF, 0xFF, 0xFF, 0xFF, 0xFF, 0xFF, 0xFF, 0xFF, 0xFF, 0xFF,
0x80, 0x00, 0x00, 0x00, 0x00, 0x00, 0x00, 0x01, 0x00, 0x00, 0x00, 0x00, 0x00, 0x00, 0x00, 0x01,
0x81, 0xE0, 0x00, 0x00, 0x00, 0x00, 0x00, 0x01, 0x00, 0x00, 0x00, 0x00, 0x00, 0x00, 0x00, 0x01,
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0xFF, 0xFF, 0xFF, 0xFF, 0xFF, 0xFF, 0xFF, 0xFF, 0xFF, 0xFF, 0xFF, 0xFF, 0xFF, 0xFF, 0xFF, 0xFF
};


String Format(int val, int dec, int dig ,int len) {

  // this is my simple way of formatting a number
  // data = Format(number, digits, decimals) when needed

  int addpad = 0;
  char sbuf[20];
  String fdata = (dtostrf(val, dec, dig, sbuf));
  int slen = fdata.length();
  if (slen<=len){
 //
    for ( addpad = 1; addpad <=dec + dig -  slen; addpad++) {
      fdata = "0" + fdata;
    }
  }else{
    fdata = fdata.substring(0,len);
    if(fdata.substring(len-1,len) == "."){
      fdata =  " "+fdata.substring(0,len-1);
    }
  }
  
  return fdata;
 
}


void testOut()
{
    static const char cmds[][7] = {"ATZ\r", "ATL1\r", "ATH0\r","ATRV\r", "0100\r", "010C\r", "0902\r","ATSP6\r"};
    //static const char cmds[][7] = {"ATSP6"};
    char buf[128];
    display.setCursor(0, 0);
    display.clearDisplay();
    for (byte i = 0; i < sizeof(cmds) / sizeof(cmds[0]); i++) {
        const char *cmd = cmds[i];
        display.print("S..");
        display.print(cmd);
        display.display();
        if (obd.sendCommand(cmd, buf, sizeof(buf))) {
            char *p = strstr(buf, cmd);
            if (p)
                p += strlen(cmd);
            else
                p = buf;
            while (*p == '\r') p++;
            while (*p) {
                display.print(*p);
                if (*p == '\r' && *(p + 1) != '\r')
                    display.println();
                p++;
            }
        } else {
            display.println(" Timeout");
            
        }
        display.display();
        delay(200);
        display.clearDisplay();
        display.setCursor(0, 0);
    }
    display.println("Exit");
    display.display();
}


void readPIDMultiple()
{
    for (byte i = 0; i < sizeof(pids) ; i++) {
      obd.readPID(pids[i], values[i]);
      //values[i]=i;
    }
}



void setup()
{

  delay(500);
  display.begin(SSD1306_SWITCHCAPVCC, 0x3c);  // initialize with the I2C addr 0x3D (for the 128x64)

  // Clear the buffer.
  display.clearDisplay();
  // miniature bitmap display
  display.drawBitmap(0,0,test,128,64,WHITE);
  display.display();
  delay(1000);
  display.clearDisplay();
  display.setTextColor(WHITE, BLACK);
  display.setTextSize(1);
  display.setCursor(0, 0);
  display.print("Start!!..");
  display.display();
  delay(500);
  

  obd.begin();
  // send some commands for testing and show response
  //testOut();

  display.print("Finish Test out");
  display.display();
  delay(500);
  /*do {
    display.print("protocal");
    display.println();
    display.display();
  } while (!obd.init());
*/

 
}

//static const byte pids[] = {PID_SPEED, PID_ENGINE_LOAD, PID_THROTTLE, PID_COOLANT_TEMP, PID_RPM,PID_CONTROL_MODULE_VOLTAGE,PID_FUEL_LEVEL};
void loop()
{
 display.clearDisplay();
 display.drawBitmap(0,0,TempLogo,128,64,WHITE);

 readPIDMultiple();
 volt = obd.getVoltage();

 
 display.setTextSize(2);
 display.setCursor(15, 15);
 display.print(Format(values[3], 3,0,3));
 
 display.setTextSize(1);
 display.setCursor(20, 40);
 display.print(Format(volt, 3, 1,3));
 display.print(" V.");
 display.setCursor(20, 50);
 display.print(Format(values[6], 3, 1,3));
 display.print(" %");

 display.setCursor(66, 2);
  display.print("RPM:");
 display.print(Format(values[4], 4,0,4));
 display.setCursor(66, 10);
 display.print("TH.:");
 display.print(Format(values[2],3, 0,3));
  display.print(" %");
 display.setCursor(66, 18);
  display.print("LD.:");
 display.print(Format(values[1], 3,0,3));
 display.print(" %");

 display.setTextSize(2);
 display.setCursor(66, 40);
 display.print(Format(values[0], 3,0,3));
 display.setTextSize(1);
 display.setCursor(102, 47);
 display.print("k/h");
 display.display();
 delay(100);



}

